## prj.conf
```kconfig
CONFIG_GPIO=y
CONFIG_PRINTK=y
CONFIG_UART_CONSOLE=y
CONFIG_CONSOLE=y
CONFIG_STDOUT_CONSOLE=y
```

## src/main.c
```c
#include <zephyr/kernel.h>
#include <zephyr/sys/printk.h>

int main(void)
{
    int a = 10, b = 20;

    printk("ESP32 Zephyr Started\r\n");
    printk("Sum = %d\r\n", a + b);

    while (1) {
        printk("Running...\r\n");
        k_msleep(1000);
    }
}
```
